## app/boards/arm/bluemacro840/Kconfig.defconfig
```kconfig
# BlueMacro840 board configuration

# Copyright (c) 2020 The ZMK Contributors
# SPDX-License-Identifier: MIT

if BOARD_BLUEMACRO840_V1

config BOARD
	default "bluemacro840_v1"

if USB_DEVICE_STACK

config USB_NRFX
	default y

endif # USB_DEVICE_STACK

config BT_CTLR
	default BT

config ZMK_BLE
	default y

config ZMK_USB
	default y

config ZMK_BATTERY_VOLTAGE_DIVIDER
	default y

endif # BOARD_BLUEMACRO840_V1
```

## app/boards/shields/helen80/Kconfig.defconfig
```kconfig
if SHIELD_HELEN80

config ZMK_KEYBOARD_NAME
    default "Helen80 with ZMK"

endif
```

## app/boards/shields/k375tkl/Kconfig.defconfig
```kconfig
if SHIELD_K375TKL

config ZMK_KEYBOARD_NAME
    default "K375 TKL with ZMK"

endif
```
